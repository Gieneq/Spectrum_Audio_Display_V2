#pragma once

#include "arm_math.h"
#include "arm_const_structs.h"
#include <stdio.h>

// If problem with __FPU_PRESENT then add in settings/preproc symbol: __FPU_PRESENT

// Data generated using Jupyter Notebook. The signal mixes 30 Hz, 19999 Hz and white noise.
#define TEST_SAMPLES_COUNT 1024
const float32_t test_signal[TEST_SAMPLES_COUNT] = {0.1624, -0.0287, -0.0983, -0.0188, 0.0127, -0.1097, 0.1012, 0.0448, -0.0093, 0.0676, 0.161, -0.1591, 0.0475,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 -0.9816, -1.0097};

// Len of mags = 1024 should be equal to len of time samples = 1024. Use half.
const float32_t test_megs[TEST_SAMPLES_COUNT] = {311.6108, 420.9747, 98.1827, 58.7931, 42.6959, 34.219, 27.1659, 22.0502, 23.3506, 17.9231, 15.8833, 14.1972, 12.3149,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 98.1827, 420.9747};

#define INTERVAL 10000

float32_t Input[TEST_SAMPLES_COUNT*2];
float32_t Output[TEST_SAMPLES_COUNT];

/* Reference index at which max energy of bin ocuurs */
uint32_t refIndex = 213, testIndex = 0;

static float32_t get_comparison_error(const float32_t* ref_mags, const float32_t* test_mags, int count) {
	static float32_t cmp_error = 0, rel_error=0;

	for (int i = 0; i < count; ++i) {
		rel_error = (ref_mags[i] - test_mags[i]) / ref_mags[i];
		cmp_error += rel_error < 0 ? -rel_error : rel_error;
	}
	return 100*cmp_error/count;
}

void execute_testbench() {
	float32_t maxValue;				/* Max FFT value is stored here */
	uint32_t maxIndex;				/* Index in Output array where max value is */
	int i = 0;

	/* Real part, make offset by ADC / 2 */
	for (i = 0; i < TEST_SAMPLES_COUNT*2; i+=2)
		Input[i] = (float32_t)(test_signal[i/2]);

	/* Imaginary part, make offset by ADC / 2 + 1 */
	for (i = 1; i < TEST_SAMPLES_COUNT*2; i+=2)
		Input[i] = 0;

	/* Process the data through the CFFT/CIFFT module */
	assert(TEST_SAMPLES_COUNT == 1024);
	arm_cfft_f32(&arm_cfft_sR_f32_len1024, Input, 0, 1);

	/* Process the data through the Complex Magniture Module for calculating the magnitude at each bin */
	arm_cmplx_mag_f32(Input, Output, TEST_SAMPLES_COUNT);

	/* Calculates maxValue and returns corresponding value */
	arm_max_f32(Output, TEST_SAMPLES_COUNT, &maxValue, &maxIndex);

	float32_t mean_rel_error = get_comparison_error(test_megs, Output, TEST_SAMPLES_COUNT);
	printf("FFT EVALUATION DONE with error: %.3f %%\n\n", mean_rel_error);

	printf("START INPUT SIGNAL %d:\n", TEST_SAMPLES_COUNT);
	for (i = 0; i < TEST_SAMPLES_COUNT; i++)
		printf("%f, ",  test_signal[i]);
	printf("\n");
	printf("STOP INPUT SIGNAL\n\n");


	//retrive half
	printf("START MAGNITUDES %d:\n", TEST_SAMPLES_COUNT/2);
	for (i = 0; i < TEST_SAMPLES_COUNT/2; i++)
		printf("%f, ",  Output[i]);
	printf("\n");
	printf("STOP MAGNITUDES\n\n");


	//full to reconstruct
	printf("START REAL %d:\n", TEST_SAMPLES_COUNT);
	for (i = 0; i < TEST_SAMPLES_COUNT*2; i+=2)
		printf("%f, ",  Input[i]);
	printf("\n");
	printf("STOP REAL\n\n");


	//full to reconstruct
	printf("START IMAG %d:\n", TEST_SAMPLES_COUNT);
	for (i = 1; i < TEST_SAMPLES_COUNT*2; i+=2)
		printf("%f, ",  Input[i]);
	printf("\n");
	printf("STOP IMAG\n\n");


	printf("START TEST, IT WILL TAKE %d MS...\n", INTERVAL);
	uint32_t start_millis = HAL_GetTick();
	float delta_millis = 0;
	int counter = 0;

	while(HAL_GetTick() - start_millis < INTERVAL) {
		arm_cmplx_mag_f32(Input, Output, TEST_SAMPLES_COUNT);
		++counter;
	}

	delta_millis = HAL_GetTick() - start_millis;
	printf("STOP TEST! DONE %d ITERATIONS AND (WITH %d FFT POINTS) GOT %d Hz REFRESH RATE (T = %d US), ERROR: %.3f%%.\n", counter, TEST_SAMPLES_COUNT, (int)(counter*1000.0/delta_millis), (int)(delta_millis*1000.0/counter), mean_rel_error);
}
